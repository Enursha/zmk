## app/module/drivers/sensor/pmw3320/Kconfig
```kconfig
# Copyright (c) 2022 The ZMK Contributors
# SPDX-License-Identifier: MIT
config PMW3320
	bool "Enable PMW3320 Mouse Sensor"
	depends on SPI
	help
	  Enable mouse sensor

		The PMW3320 is a 16-bit optical mouse sensor

choice
	prompt "Trigger mode"
	default PMW3320_TRIGGER_NONE
	help
	  Specify the type of triggering to be used by the driver.

config PMW3320_TRIGGER_NONE
	bool "No trigger"

config PMW3320_TRIGGER_GLOBAL_THREAD
	bool "Use global thread"
	depends on GPIO
	select PMW3320_TRIGGER

config PMW3320_TRIGGER_OWN_THREAD
	bool "Use own thread"
	depends on GPIO
	select PMW3320_TRIGGER

endchoice

config PMW3320_TRIGGER
	bool

config PMW3320_THREAD_PRIORITY
	int "Thread priority"
	depends on PMW3320_TRIGGER_OWN_THREAD
	default 10
	help
	  Priority of thread used by the driver to handle interrupts.

config PMW3320_THREAD_STACK_SIZE
	int "Thread stack size"
	depends on PMW3320_TRIGGER_OWN_THREAD
	default 1024
	help
	  Stack size of thread used by the driver to handle interrupts.

endif # PMW3320
```
